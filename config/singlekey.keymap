/ {
    keymap {
        compatible = "zmk,keymap";

        default_layer {
            bindings = <
                &kp C_PP
                &kp C_VOL_UP
            >;
        };
    };

    kscan0: kscan {
        compatible = "zmk,kscan-gpio-direct";

        input-gpios = <
            &gpio1 4 (GPIO_ACTIVE_LOW | GPIO_PULL_UP)
            &gpio1 6 (GPIO_ACTIVE_LOW | GPIO_PULL_UP)
        >;

        debounce-press-ms = <5>;
        debounce-release-ms = <5>;
    };
};